/*
 * Copyright (c) 2025 Vincent Franco
 *
 * SPDX-License-Identifier: MIT
 */
#include <dt-bindings/zmk/matrix_transform.h>
#include <dt-bindings/zmk/input_transform.h>
#include <input/processors.dtsi>


  //left hand trackball
  split_inputs {
    #address-cells = <1>;
    #size-cells = <0>;

    trackball_peripheral_split: trackball_peripheral_split@0 {
      compatible = "zmk,input-split";
      reg = <0>;
    };
  };

  trackball_peripheral_listener: trackball_peripheral_listener {
    compatible = "zmk,input-listener";
    status = "disabled";
    device = <&trackball_peripheral_split>;
  };

  //right hand trackball
  trackball_central_listener: trackball_central_listener {
    compatible = "zmk,input-listener";
    status = "disabled";
  };
};
